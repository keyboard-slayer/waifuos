## Kconfig
```kconfig
mainmenu "WaifuOS menuconfig"

source "src/kernel/Kconfig"
source "src/libs/kawaii-embed/Kconfig"

menu "Emulation options"
    config ENBABLE_KVM
        bool "Enable KVM"
        depends on !DUMP_INTERRUPT
        default y
        help
            Enable KVM support.

    config DUMP_INTERRUPT
        bool "Dump interrupt state"
        default n
        help 
            Dump interrupt state on each interrupt.
    

    config NO_POWEROFF
        bool "No poweroff"
        default n
        help
            Do not power off the machine when the kernel exits.
    
    config MEMORY
        int "Memory size (MB)"
        default 256
        help
            Memory size in MB.
    
    config CPU_CORE
        int "Cpu Core"
        default 4
        help
            Cpu Core.

    config EFI_BIOS_PATH
        string "EFI bios path"
        default "/usr/share/ovmf/x64/OVMF_CODE.fd"
        depends on LOADER_EFI
        help
            EFI bios path.
endmenu
```

## src/arch/x86_64/Kconfig
```kconfig
menu "Devices"
    visible if ARCH_X86-64

    menu "Serial"
        config SERIAL_PORT
            int "Serial port"
            default 1
            help
              This is the serial port that the kernel will use for console
              output.
        
        config BAUD_RATE
            int "Baud rate"
            default 9600
            help
                This is the speed of the serial communication
    endmenu
endmenu
```

## src/libs/kawaii-embed/Kconfig
```kconfig
menu "Bootloader"
    choice
        prompt "Bootloader to use"
        default LOADER_LIMINE
        help 
            Select the bootloader to use.
            The default is limine.

        config LOADER_LIMINE
            bool "Limine"
            depends on ARCH_X86-64
            help
                Use limine as bootloader.
    endchoice

    config LOADER_EFI
        bool "EFI"
        depends on LOADER_LIMINE
        default y
endmenu

choice
    prompt "Architecture"
    default ARCH_X86-64

config ARCH_X86-64
    bool "x86 (64-bit) architecture"

endchoice

source "src/arch/x86_64/Kconfig"
```
